## configs/save/batocera-h700_armhf_munge_defconfig
```kconfig
# from file batocera-board.libs
# users
BR2_ROOTFS_USERS_TABLES="$(BR2_EXTERNAL_BATOCERA_PATH)/board/batocera/users.txt"

# toolchain definition
BR2_OPTIMIZE_2=y
BR2_ENABLE_LTO=y
BR2_SHARED_STATIC_LIBS=y
BR2_GCC_ENABLE_GRAPHITE=y
BR2_TOOLCHAIN_BUILDROOT_GLIBC=y
BR2_TOOLCHAIN_BUILDROOT_CXX=y
# required for utf-8
BR2_TOOLCHAIN_GLIBC_GCONV_LIBS_COPY=y
BR2_STRIP_EXCLUDE_DIRS="usr/ryujinx usr/bin/vpinball usr/share/ecwolf usr/bin/vita3k usr/bin/dmdserver"

# Allow to build GOLD linker, but do not use as default
BR2_BINUTILS_EXTRA_CONFIG_OPTIONS="--enable-gold --enable-plugins"

# prefer linux tools over busybox tools
BR2_PACKAGE_BUSYBOX=n
#BR2_PACKAGE_BC=y
#BR2_PACKAGE_COREUTILS=y
#BR2_PACKAGE_DIFFUTILS=y
#BR2_PACKAGE_DOS2UNIX=y
#BR2_PACKAGE_FINDUTILS=y
#BR2_PACKAGE_GAWK=y
#BR2_PACKAGE_GREP=y
#BR2_PACKAGE_GZIP=y
#BR2_PACKAGE_IFUPDOWN=y
#BR2_PACKAGE_IPUTILS=y
#BR2_PACKAGE_KMOD=y
#BR2_PACKAGE_KMOD_TOOLS=y
#BR2_PACKAGE_LESS=y
#BR2_PACKAGE_LSOF=y
#BR2_PACKAGE_NCURSES=y
#BR2_PACKAGE_NCURSES_TARGET_PROGS=y
#BR2_PACKAGE_NETCAT=y
#BR2_PACKAGE_NET_TOOLS=y
#BR2_PACKAGE_NFS_UTILS=y
#BR2_PACKAGE_NFS_UTILS_NFSV4=y
#BR2_PACKAGE_PROCPS_NG=y
#BR2_PACKAGE_PSMISC=y
#BR2_PACKAGE_SED=y
#BR2_PACKAGE_START_STOP_DAEMON=y
#BR2_PACKAGE_SYSKLOGD=y
#BR2_PACKAGE_TAR=y
#BR2_PACKAGE_UNRAR=y
#BR2_PACKAGE_UTIL_LINUX_AGETTY=y
#BR2_PACKAGE_UTIL_LINUX_BINARIES=y
#BR2_PACKAGE_UTIL_LINUX_EJECT=y
#BR2_PACKAGE_UTIL_LINUX_HWCLOCK=y
#BR2_PACKAGE_UTIL_LINUX_KILL=y
#BR2_PACKAGE_UTIL_LINUX_LOGGER=y
#BR2_PACKAGE_UTIL_LINUX_LOGIN=y
#BR2_PACKAGE_UTIL_LINUX_MORE=y
#BR2_PACKAGE_UTIL_LINUX_MOUNT=y
#BR2_PACKAGE_UTIL_LINUX_SU=y
#BR2_PACKAGE_UTIL_LINUX_FALLOCATE=y
#BR2_PACKAGE_WATCHDOG=y
#BR2_PACKAGE_WHICH=y

# system
BR2_TARGET_GENERIC_HOSTNAME="knulli"
BR2_TARGET_GENERIC_ISSUE="knulli"
BR2_INIT_SYSV=y
BR2_ROOTFS_DEVICE_CREATION_DYNAMIC_EUDEV=y
BR2_TARGET_GENERIC_ROOT_PASSWD="linux"
BR2_SYSTEM_ENABLE_NLS=y
BR2_ENABLE_LOCALE_WHITELIST="C ar ca cs_CZ cy cy_GB cy de en el es es_MX eu eu_ES fr fr_FR fi_FI gl_ES he hu id_ID it ja ja_JP ja ko nb nb_NO nl nn nn_NO oc oc_FR pl pt pt_PT pt_BR ru ru_RU uk uk_UA ro_RO sk_SK sv sv_SE tr vi_VN zh zh_CN zh_TW"
BR2_GENERATE_LOCALE="en_US.UTF-8 ar_YE.UTF-8 ca_ES.UTF-8 cs_CZ.UTF-8 cy_GB.UTF-8 de_DE.UTF-8 el_GR.UTF-8 en_GB.UTF-8 es_ES.UTF-8 es_MX.UTF-8 eu_ES.UTF-8 fr_FR.UTF-8 fi_FI.UTF-8 gl_ES.UTF-8 he_IL.UTF-8 hu_HU.UTF-8 id_ID.UTF-8 it_IT.UTF-8 ja_JP.UTF-8 ko_KR.UTF-8 nb_NO.UTF-8 nl_NL.UTF-8 nn_NO.UTF-8 oc_FR.UTF-8 pl_PL.UTF-8 pt_BR.UTF-8 pt_PT.UTF-8 ru_RU.UTF-8 uk_UA.UTF-8 ro_RO.UTF-8 sk_SK.UTF-8 sv_SE.UTF-8 tr_TR.UTF-8 vi_VN.UTF-8 zh_CN.UTF-8 zh_TW.UTF-8"
BR2_TARGET_TZ_INFO=y
BR2_TARGET_LOCALTIME="Europe/Paris"
# BR2_TARGET_GENERIC_REMOUNT_ROOTFS_RW is not set

# Initramfs decompression support
BR2_LINUX_KERNEL_LZ4=y

# Python choices
#BR2_PACKAGE_PYTHON3_PY_PYC=y
#BR2_PACKAGE_PYTHON_HASHLIB=y
#BR2_PACKAGE_PYTHON3_BZIP2=y
#BR2_PACKAGE_PYTHON3_XZ=y

#BR2_PACKAGE_ESPEAK=y
#BR2_PACKAGE_ESPEAK_AUDIO_BACKEND_ALSA=y
#BR2_PACKAGE_GLIBC_UTILS=y

# disable the mosquitto broker which is on by default
BR2_PACKAGE_MOSQUITTO_BROKER=n

# System
BR2_PACKAGE_BATOCERA_SYSTEM=n
BR2_PACKAGE_BATOCERA_EXTRAS=n
BR2_PACKAGE_BATOCERA_TOOLS=n
BR2_PACKAGE_BATOCERA_ALL_SYSTEMS=n
BR2_PACKAGE_BATOCERA_LINUX_FIRMWARES=n
BR2_SYSTEM_BIN_SH_DASH=y # /bin/sh implementation; set here because a `choice` cannot be `select`ed, e.g. from batocera-system/Config.in

# Enables ccache
BR2_CCACHE=y

### from board file ###

# Target definition
BR2_arm=y
BR2_ARM_EABIHF=y
BR2_cortex_a53=y
BR2_ARM_FPU_NEON_FP_ARMV8=y
BR2_PACKAGE_BATOCERA_TARGET_H700=y
BR2_TARGET_OPTIMIZATION="-pipe -fsigned-char -mcpu=cortex-a53 -mtune=cortex-a53"
#BR2_TARGET_GENERIC_GETTY_PORT="tty1"
BR2_TARGET_GENERIC_GETTY_BAUDRATE_115200=y
BR2_GLOBAL_PATCH_DIR="$(BR2_EXTERNAL_BATOCERA_PATH)/board/batocera/patches $(BR2_EXTERNAL_BATOCERA_PATH)/board/batocera/allwinner/patches $(BR2_EXTERNAL_BATOCERA_PATH)/board/batocera/allwinner/h700/patches"

# Build tar file only
BR2_TARGET_ROOTFS_TAR=y
BR2_TARGET_ROOTFS_TAR_NONE=y

# Batocera system
BR2_PACKAGE_BATOCERA_KODI20=n


######
# Linux headers same as kernel, a 4.9 series
BR2_LINUX_KERNEL=y
BR2_KERNEL_HEADERS_AS_KERNEL=y
BR2_LINUX_KERNEL_USE_CUSTOM_CONFIG=y
BR2_LINUX_KERNEL_CUSTOM_CONFIG_FILE="$(BR2_EXTERNAL_BATOCERA_PATH)/board/batocera/allwinner/h700/linux-sunxi64-legacy.config"
BR2_PACKAGE_HOST_LINUX_HEADERS_CUSTOM_4_9=y
BR2_LINUX_KERNEL_CUSTOM_VERSION_VALUE="4.9.170"
BR2_LINUX_KERNEL_VERSION="4.9.170"
BR2_KERNEL_HEADERS_VERSION=y
BR2_DEFAULT_KERNEL_VERSION="4.9.170"
BR2_PACKAGE_HOST_LINUX_HEADERS_CUSTOM_4_9=y
BR2_DEFAULT_KERNEL_HEADERS="4.9.170"
BR2_TOOLCHAIN_HEADERS_AT_LEAST="4.9"

BR2_PACKAGE_HAS_LIBMALI=y
BR2_PACKAGE_PROVIDES_LIBMALI="mali-g31-fbdev"
BR2_PACKAGE_MALI_G31_FBDEV=y

## To enable libFLAC++
BR2_INSTALL_LIBSTDCPP=y

## Frequently used libraries
BR2_PACKAGE_PANGO=y
BR2_PACKAGE_LIBGCRYPT=y
BR2_PACKAGE_LIBCAP_NG=y
BR2_PACKAGE_LIBCAPSIMAGE=y
BR2_PACKAGE_LIBCAP=y
BR2_PACKAGE_LIBCEC=y
BR2_PACKAGE_CMOCKA=y
BR2_PACKAGE_LIBCURL=y
BR2_PACKAGE_LIBDAEMON=y
BR2_PACKAGE_LIBEGL=y
BR2_PACKAGE_ENET=y
BR2_PACKAGE_LIBEPOXY=y
BR2_PACKAGE_LIBEVENT=y
BR2_PACKAGE_EXPAT=y
BR2_PACKAGE_FMT=y
BR2_PACKAGE_FONTCONFIG=y
BR2_PACKAGE_LIBFREEAPTX=y
BR2_PACKAGE_LIBFREEIMAGE=y
BR2_PACKAGE_FREETYPE=y
BR2_PACKAGE_LIBFRIBIDI=y
BR2_PACKAGE_GMP=y
BR2_PACKAGE_HARFBUZZ=y
BR2_PACKAGE_HISTORY=y
BR2_PACKAGE_IIR=y
BR2_PACKAGE_JANSSON=y
BR2_PACKAGE_JOSE=y
BR2_PACKAGE_JQ=y
BR2_PACKAGE_JSON_C=y
BR2_PACKAGE_KEYUTILS=y
BR2_PACKAGE_KMOD=y
BR2_PACKAGE_LIBLC3=y
BR2_PACKAGE_LIBLCF=y
BR2_PACKAGE_LIBLOCKFILE=y
BR2_PACKAGE_LUA=y
BR2_PACKAGE_LZMA=y
BR2_PACKAGE_LIBMALI=y
BR2_PACKAGE_LIBMINIUPNPC=y
BR2_PACKAGE_NGHTTP2=y
BR2_PACKAGE_LIBPCAP=y
BR2_PACKAGE_PCRE=y
BR2_PACKAGE_POPPLER=y
BR2_PACKAGE_POPT=y
BR2_PACKAGE_PUGIXML=y
BR2_PACKAGE_READLINE=y
BR2_PACKAGE_LIBSERIALPORT=y
BR2_PACKAGE_SLIRP=y
BR2_PACKAGE_SPIRV_TOOLS=y
BR2_PACKAGE_LIBTASN1=y
BR2_PACKAGE_TINYXML2=y
BR2_PACKAGE_LIBTIRPC=y
BR2_PACKAGE_UDEV=y
BR2_PACKAGE_LIBUNISTRING=y
BR2_PACKAGE_LIBVPX=y
BR2_PACKAGE_WILDMIDI=y
BR2_PACKAGE_X264=y
BR2_PACKAGE_X265=y
BR2_PACKAGE_LIBXML2=y
BR2_PACKAGE_LIBXMP=y
BR2_PACKAGE_LIBYAML=y
BR2_PACKAGE_ZSTD=y
BR2_PACKAGE_HIDAPI=y
BR2_PACKAGE_LIBEVDEV=y
BR2_PACKAGE_INOTIFY_TOOLS=y
BR2_PACKAGE_LIRC_TOOLS=y
BR2_PACKAGE_SYSLOG_NG=y

# Individual options are not set unless chosen here
BR2_PACKAGE_BOOST=y
BR2_PACKAGE_BOOST_ATOMIC=y
BR2_PACKAGE_BOOST_CONTEXT_ARCH_SUPPORTS=y
BR2_PACKAGE_BOOST_DATE_TIME=y
BR2_PACKAGE_BOOST_FILESYSTEM=y
BR2_PACKAGE_BOOST_IOSTREAMS=y
BR2_PACKAGE_BOOST_NOWIDE=y
BR2_PACKAGE_BOOST_PROGRAM_OPTIONS=y
BR2_PACKAGE_BOOST_SYSTEM=y

## AV libraries
BR2_PACKAGE_LIBASS=y
BR2_PACKAGE_FFMPEG_PYTHON=y
BR2_PACKAGE_FFMPEG_AVRESAMPLE=y

BR2_PACKAGE_FFMPEG4=y

BR2_PACKAGE_WIREPLUMBER=y
BR2_PACKAGE_GIFLIB=y
BR2_PACKAGE_LIBV4L=y
BR2_PACKAGE_LIBGRAPHENE=y
BR2_PACKAGE_OPENCV4=y
BR2_PACKAGE_OPENCV4_LIB_IMGCODECS=y
BR2_PACKAGE_OPENCV4_LIB_IMGPROC=y
BR2_PACKAGE_OPENCV4_LIB_PYTHON=y
BR2_PACKAGE_OPENCV4_LIB_VIDEOIO=y
BR2_PACKAGE_OPENCV4_LIB_VIDEO=y
BR2_PACKAGE_OPENCV4_WITH_FFMPEG=y
BR2_PACKAGE_OPENCV4_WITH_GSTREAMER1=y
BR2_PACKAGE_OPENCV4_JPEG2000_NONE=y
BR2_PACKAGE_LIBPLACEBO=y
BR2_PACKAGE_WEBP=y
BR2_PACKAGE_WEBP_DEMUX=y
BR2_PACKAGE_WEBP_MUX=y
BR2_PACKAGE_JPEG_TURBO=y
BR2_PACKAGE_LIBMPEG2=y
BR2_PACKAGE_LIBAIO=y
BR2_PACKAGE_LIBOGG=y
BR2_PACKAGE_LIBOPENCL=y
BR2_PACKAGE_LIBOPENH264=y
BR2_PACKAGE_LIBPORTMIDI=y
BR2_PACKAGE_LIBTHEORA=y
BR2_PACKAGE_ZMUSIC=y
BR2_PACKAGE_LIBPNG=y

## Autogenerated from here on
BR2_PACKAGE_ALSA_UTILS=y
BR2_PACKAGE_ALSA_UTILS_ACONNECT=y
BR2_PACKAGE_ALSA_UTILS_ALSACTL=y
BR2_PACKAGE_ALSA_UTILS_ALSAMIXER=y
BR2_PACKAGE_ALSA_UTILS_ALSAUCM=y
BR2_PACKAGE_ALSA_UTILS_AMIXER=y
BR2_PACKAGE_ALSA_UTILS_APLAY=y
BR2_PACKAGE_ALSA_UTILS_APLAYMIDI=y
BR2_PACKAGE_ALSA_UTILS_ALSAINFO=y
BR2_PACKAGE_ESPEAK=y
BR2_PACKAGE_ESPEAK_AUDIO_BACKEND_ALSA=y
BR2_PACKAGE_FAAD2=y
BR2_PACKAGE_FFMPEG_ARCH_SUPPORTS=y
BR2_PACKAGE_FFMPEG=y
BR2_PACKAGE_FFMPEG_GPL=y
BR2_PACKAGE_FFMPEG_FFMPEG=y
BR2_PACKAGE_FFMPEG_FFPROBE=y
BR2_PACKAGE_FFMPEG_POSTPROC=y
BR2_PACKAGE_FFMPEG_SWSCALE=y
BR2_PACKAGE_FFMPEG_ENCODERS="all"
BR2_PACKAGE_FFMPEG_DECODERS="all"
BR2_PACKAGE_FFMPEG_MUXERS="all"
BR2_PACKAGE_FFMPEG_DEMUXERS="all"
BR2_PACKAGE_FFMPEG_PARSERS="all"
BR2_PACKAGE_FFMPEG_BSFS="all"
BR2_PACKAGE_FFMPEG_PROTOCOLS="all"
BR2_PACKAGE_FFMPEG_FILTERS="all"
BR2_PACKAGE_FFMPEG_INDEVS=y
BR2_PACKAGE_FFMPEG_OUTDEVS=y
BR2_PACKAGE_FFMPEG_EXTRACONF=""
BR2_PACKAGE_FLAC=y
BR2_PACKAGE_FLUID_SOUNDFONT=y
BR2_PACKAGE_FLUIDSYNTH=y
BR2_PACKAGE_FLUIDSYNTH_ALSA_LIB=y
BR2_PACKAGE_FLUIDSYNTH_SDL2=y
BR2_PACKAGE_GSTREAMER1=y
BR2_PACKAGE_GSTREAMER1_PARSE=y
BR2_PACKAGE_GSTREAMER1_TRACE=y
BR2_PACKAGE_GSTREAMER1_GST_DEBUG=y
BR2_PACKAGE_GSTREAMER1_PLUGIN_REGISTRY=y
BR2_PACKAGE_GSTREAMER1_INSTALL_TOOLS=y
BR2_PACKAGE_GST1_PLUGINS_BASE=y
BR2_PACKAGE_GST1_PLUGINS_BASE_PLUGIN_APP=y
BR2_PACKAGE_GST1_PLUGINS_BASE_PLUGIN_AUDIOCONVERT=y
BR2_PACKAGE_GST1_PLUGINS_BASE_PLUGIN_ENCODING=y
BR2_PACKAGE_GST1_PLUGINS_BASE_PLUGIN_VIDEOCONVERTSCALE=y
BR2_PACKAGE_GST1_PLUGINS_BASE_PLUGIN_PLAYBACK=y
BR2_PACKAGE_GST1_PLUGINS_BASE_PLUGIN_AUDIORESAMPLE=y
BR2_PACKAGE_GST1_PLUGINS_BASE_PLUGIN_TYPEFIND=y
BR2_PACKAGE_GST1_PLUGINS_BASE_PLUGIN_VOLUME=y
BR2_PACKAGE_GST1_PLUGINS_GOOD=y
BR2_PACKAGE_GST1_PLUGINS_GOOD_PLUGIN_AVI=y
BR2_PACKAGE_GST1_PLUGINS_GOOD_PLUGIN_ISOMP4=y
BR2_PACKAGE_GST1_PLUGINS_GOOD_PLUGIN_WAVPARSE=y
BR2_PACKAGE_GST1_PLUGINS_GOOD_PLUGIN_V4L2=y
BR2_PACKAGE_GST1_PLUGINS_GOOD_PLUGIN_V4L2_PROBE=y
BR2_PACKAGE_GST1_PLUGINS_BAD=y
BR2_PACKAGE_GST1_PLUGINS_BAD_PLUGIN_ADPCMDEC=y
BR2_PACKAGE_GST1_PLUGINS_BAD_PLUGIN_ADPCMENC=y
BR2_PACKAGE_GST1_PLUGINS_BAD_PLUGIN_MIDI=y
BR2_PACKAGE_GST1_PLUGINS_BAD_PLUGIN_FAAD=y
BR2_PACKAGE_GST1_PLUGINS_BAD_PLUGIN_FDK_AAC=y
BR2_PACKAGE_GST1_PLUGINS_BAD_PLUGIN_MPEG2ENC=y
BR2_PACKAGE_GST1_PLUGINS_BAD_PLUGIN_OPENAL=y
BR2_PACKAGE_GST1_PLUGINS_BAD_PLUGIN_OPENH264=y
BR2_PACKAGE_GST1_PLUGINS_BAD_PLUGIN_OPUS=y
BR2_PACKAGE_GST1_PLUGINS_BAD_PLUGIN_SBC=y
BR2_PACKAGE_GST1_PLUGINS_BAD_PLUGIN_VOAACENC=y
BR2_PACKAGE_GST1_PLUGINS_BAD_PLUGIN_V4L2CODECS=y
BR2_PACKAGE_GST1_PLUGINS_BAD_PLUGIN_X265=y
BR2_PACKAGE_GST1_PLUGINS_UGLY=y
BR2_PACKAGE_GST1_PLUGINS_UGLY_PLUGIN_MPEG2DEC=y
BR2_PACKAGE_GST1_PLUGINS_UGLY_PLUGIN_X264=y
BR2_PACKAGE_KODI_ARCH_SUPPORTS=y
BR2_PACKAGE_LAME=y
BR2_PACKAGE_MJPEGTOOLS=y
BR2_PACKAGE_MPG123=y
BR2_PACKAGE_MPV=y
BR2_PACKAGE_PIPEWIRE=y
BR2_PACKAGE_PIPEWIRE_GSTREAMER=y
BR2_PACKAGE_PIPEWIRE_V4L2=y
BR2_PACKAGE_PULSEAUDIO_HAS_ATOMIC=y
BR2_PACKAGE_PULSEAUDIO_ENABLE_ATOMIC=y
BR2_PACKAGE_PULSEAUDIO=y
BR2_PACKAGE_VLC=y
BR2_PACKAGE_BPFTOOL_ARCH_SUPPORTS=y
BR2_PACKAGE_BPFTRACE_ARCH_SUPPORTS=y
BR2_PACKAGE_DELVE_ARCH_SUPPORTS=y
BR2_PACKAGE_FWTS_ARCH_SUPPORTS=y
BR2_PACKAGE_GDB_ARCH_SUPPORTS=y
BR2_PACKAGE_GOOGLE_BREAKPAD_ARCH_SUPPORTS=y
BR2_PACKAGE_KEXEC_ARCH_SUPPORTS=y
BR2_PACKAGE_LTP_TESTSUITE_ARCH_SUPPORTS=y
BR2_PACKAGE_LTRACE_ARCH_SUPPORTS=y
BR2_PACKAGE_OPROFILE_ARCH_SUPPORTS=y
BR2_PACKAGE_PERFTEST_ARCH_SUPPORTS=y
BR2_PACKAGE_PLY_ARCH_SUPPORTS=y
BR2_PACKAGE_PTM2HUMAN_ARCH_SUPPORTS=y
BR2_PACKAGE_TCF_AGENT_ARCH="a64"
BR2_PACKAGE_TCF_AGENT_ARCH_SUPPORTS=y
BR2_PACKAGE_TRINITY_ARCH_SUPPORTS=y
BR2_PACKAGE_UFTRACE_ARCH_SUPPORTS=y
BR2_PACKAGE_VALGRIND_ARCH_SUPPORTS=y
BR2_PACKAGE_CMAKE_ARCH_SUPPORTS=y
BR2_PACKAGE_FLEX=y
BR2_PACKAGE_DEJAVU=y
BR2_PACKAGE_DEJAVU_MONO=y
BR2_PACKAGE_DEJAVU_SANS=y
BR2_PACKAGE_DEJAVU_SERIF=y
BR2_PACKAGE_DEJAVU_SANS_CONDENSED=y
BR2_PACKAGE_DEJAVU_SERIF_CONDENSED=y
BR2_PACKAGE_MIDORI_ARCH_SUPPORTS=y
BR2_PACKAGE_NETSURF_ARCH_SUPPORTS=y
BR2_PACKAGE_FBV=y
BR2_PACKAGE_FBV_PNG=y
BR2_PACKAGE_FBV_JPEG=y
BR2_PACKAGE_FBV_GIF=y
BR2_PACKAGE_SDL=y
BR2_PACKAGE_SDL_FBCON=y
BR2_PACKAGE_SDL_GFX=y
BR2_PACKAGE_SDL_IMAGE=y
BR2_PACKAGE_SDL_IMAGE_BMP=y
BR2_PACKAGE_SDL_IMAGE_JPEG=y
BR2_PACKAGE_SDL_IMAGE_PNG=y
BR2_PACKAGE_SDL_SOUND=y
BR2_PACKAGE_SDL_TTF=y
BR2_PACKAGE_SDL2=y
BR2_PACKAGE_SDL2_OPENGLES=y
BR2_PACKAGE_SDL2_GFX=y
BR2_PACKAGE_SDL2_IMAGE=y
BR2_PACKAGE_SDL2_MIXER=y
BR2_PACKAGE_SDL2_NET=y
BR2_PACKAGE_SDL2_TTF=y
BR2_PACKAGE_QT5_GL_AVAILABLE=y
BR2_PACKAGE_QT5_JSCORE_AVAILABLE=y
BR2_PACKAGE_QT6_ARCH_SUPPORTS=y
BR2_PACKAGE_QT6_GL_SUPPORTS=y
BR2_PACKAGE_CPUBURN_ARM_ARCH_SUPPORTS=y
BR2_PACKAGE_CRYPTSETUP=y
BR2_PACKAGE_DBUS=y
BR2_PACKAGE_DBUS_PYTHON=y
BR2_PACKAGE_EDID_DECODE=y
BR2_PACKAGE_EUDEV=y
BR2_PACKAGE_EUDEV_RULES_GEN=y
BR2_PACKAGE_EUDEV_ENABLE_HWDB=y
BR2_PACKAGE_EVTEST=y
BR2_PACKAGE_FLASHROM_ARCH_SUPPORTS=y
BR2_PACKAGE_KBD=y
BR2_PACKAGE_LUKSMETA=y
BR2_PACKAGE_LVM2=y
BR2_PACKAGE_LVM2_STANDARD_INSTALL=y
BR2_PACKAGE_MDADM=y
BR2_PACKAGE_READ_EDID=y
BR2_PACKAGE_RNG_TOOLS=y
BR2_PACKAGE_RNG_TOOLS_JITTERENTROPY_LIBRARY=y
BR2_PACKAGE_SEDUTIL_ARCH_SUPPORTS=y
BR2_PACKAGE_ERLANG_ARCH_SUPPORTS=y
BR2_PACKAGE_JANET=y
BR2_PACKAGE_JIMTCL=y
BR2_PACKAGE_LPEG=y
BR2_PACKAGE_MONO_ARCH_SUPPORTS=y
BR2_PACKAGE_NODEJS_ARCH_SUPPORTS=y
BR2_PACKAGE_OPENJDK_ARCH_SUPPORTS=y
BR2_PACKAGE_PHP_ARCH_SUPPORTS=y
BR2_PACKAGE_PYTHON3=y
BR2_PACKAGE_PYTHON3_PY_PYC=y
BR2_PACKAGE_PYTHON3_BZIP2=y
BR2_PACKAGE_PYTHON3_SSL=y
BR2_PACKAGE_PYTHON3_UNICODEDATA=y
BR2_PACKAGE_PYTHON3_PYEXPAT=y
BR2_PACKAGE_PYTHON3_XZ=y
BR2_PACKAGE_PYTHON3_ZLIB=y
BR2_PACKAGE_PYTHON_CERTIFI=y
BR2_PACKAGE_PYTHON_CHARSET_NORMALIZER=y
BR2_PACKAGE_PYTHON_EVDEV=y
BR2_PACKAGE_PYTHON_FUTURE=y
BR2_PACKAGE_PYTHON_GOBJECT=y
BR2_PACKAGE_PYTHON_GREENLET_ARCH_SUPPORTS=y
BR2_PACKAGE_PYTHON_GRPCIO_ARCH_SUPPORTS=y
BR2_PACKAGE_PYTHON_HTTPLIB2=y
BR2_PACKAGE_PYTHON_IDNA=y
BR2_PACKAGE_PYTHON_NUMPY_ARCH_SUPPORTS=y
BR2_PACKAGE_PYTHON_NUMPY=y
BR2_PACKAGE_PYTHON_PILLOW=y
BR2_PACKAGE_PYTHON_PROTOBUF=y
BR2_PACKAGE_PYTHON_PSUTIL=y
BR2_PACKAGE_PYTHON_PYPARSING=y
BR2_PACKAGE_PYTHON_PYUDEV=y
BR2_PACKAGE_PYTHON_PYYAML=y
BR2_PACKAGE_PYTHON_REQUESTS=y
BR2_PACKAGE_PYTHON_RUAMEL_YAML=y
BR2_PACKAGE_PYTHON_SETUPTOOLS=y
BR2_PACKAGE_PYTHON_SIX=y
BR2_PACKAGE_PYTHON_TOML=y
BR2_PACKAGE_PYTHON_URLLIB3=y
BR2_PACKAGE_ALSA_LIB=y
BR2_PACKAGE_ALSA_LIB_DEVDIR="/dev/snd"
BR2_PACKAGE_ALSA_LIB_PCM_PLUGINS="all"
BR2_PACKAGE_ALSA_LIB_CTL_PLUGINS="all"
BR2_PACKAGE_ALSA_LIB_ALOAD=y
BR2_PACKAGE_ALSA_LIB_MIXER=y
BR2_PACKAGE_ALSA_LIB_PCM=y
BR2_PACKAGE_ALSA_LIB_RAWMIDI=y
BR2_PACKAGE_ALSA_LIB_HWDEP=y
BR2_PACKAGE_ALSA_LIB_SEQ=y
BR2_PACKAGE_ALSA_LIB_UCM=y
BR2_PACKAGE_ALSA_LIB_ALISP=y
BR2_PACKAGE_ALSA_LIB_OLD_SYMBOLS=y
BR2_PACKAGE_ALSA_LIB_TOPOLOGY=y
BR2_PACKAGE_ALSA_PLUGINS=y
BR2_PACKAGE_FDK_AAC_ARCH_SUPPORTS=y
BR2_PACKAGE_FDK_AAC=y
BR2_PACKAGE_LIBAO=y
BR2_PACKAGE_LIBMAD=y
BR2_PACKAGE_LIBMAD_OPTIMIZATION_DEFAULT=y
BR2_PACKAGE_LIBMAD_ASO=y
BR2_PACKAGE_LIBMODPLUG=y
BR2_PACKAGE_LIBSAMPLERATE=y
BR2_PACKAGE_LIBSNDFILE=y
BR2_PACKAGE_LIBVORBIS=y
BR2_PACKAGE_OPENAL_ARCH_SUPPORTS=y
BR2_PACKAGE_OPENAL=y
BR2_PACKAGE_OPUS=y
BR2_PACKAGE_OPUSFILE=y
BR2_PACKAGE_PORTAUDIO=y
BR2_PACKAGE_PORTAUDIO_ALSA=y
BR2_PACKAGE_PORTAUDIO_CXX=y
BR2_PACKAGE_SBC=y
BR2_PACKAGE_SPEEXDSP=y
BR2_PACKAGE_VO_AACENC=y
BR2_PACKAGE_WEBRTC_AUDIO_PROCESSING_ARCH_SUPPORTS=y
BR2_PACKAGE_LIBARCHIVE=y
BR2_PACKAGE_LIBARCHIVE_BSDTAR=y
BR2_PACKAGE_LIBARCHIVE_BSDCPIO=y
BR2_PACKAGE_LIBARCHIVE_BSDCAT=y
BR2_PACKAGE_LIBZIP=y
BR2_PACKAGE_LZ4=y
BR2_PACKAGE_LZO=y
BR2_PACKAGE_ZLIB_NG_ARCH_SUPPORTS=y
BR2_PACKAGE_ZLIB=y
BR2_PACKAGE_LIBZLIB=y
BR2_PACKAGE_BOTAN_ARCH_SUPPORTS=y
BR2_PACKAGE_CA_CERTIFICATES=y
BR2_PACKAGE_GNUTLS=y
BR2_PACKAGE_LIBARGON2=y
BR2_PACKAGE_LIBASSUAN=y
BR2_PACKAGE_LIBGPG_ERROR_ARCH_SUPPORTS=y
BR2_PACKAGE_LIBGPG_ERROR=y
BR2_PACKAGE_LIBGPGME=y
BR2_PACKAGE_LIBSODIUM=y
BR2_PACKAGE_LIBSODIUM_FULL=y
BR2_PACKAGE_LIBSPDM_ARCH_SUPPORTS=y
BR2_PACKAGE_LIBXCRYPT=y
BR2_PACKAGE_NETTLE=y
BR2_PACKAGE_LIBRESSL_ARCH_SUPPORTS=y
BR2_PACKAGE_OPENSSL_FORCE_LIBOPENSSL=y
BR2_PACKAGE_OPENSSL=y
BR2_PACKAGE_LIBOPENSSL=y
BR2_PACKAGE_LIBOPENSSL_BIN=y
BR2_PACKAGE_LIBOPENSSL_ENABLE_CHACHA=y
BR2_PACKAGE_LIBOPENSSL_ENABLE_RC2=y
BR2_PACKAGE_LIBOPENSSL_ENABLE_RC4=y
BR2_PACKAGE_LIBOPENSSL_ENABLE_MD2=y
BR2_PACKAGE_LIBOPENSSL_ENABLE_MD4=y
BR2_PACKAGE_LIBOPENSSL_ENABLE_MDC2=y
BR2_PACKAGE_LIBOPENSSL_ENABLE_BLAKE2=y
BR2_PACKAGE_LIBOPENSSL_ENABLE_IDEA=y
BR2_PACKAGE_LIBOPENSSL_ENABLE_SEED=y
BR2_PACKAGE_LIBOPENSSL_ENABLE_DES=y
BR2_PACKAGE_LIBOPENSSL_ENABLE_RMD160=y
BR2_PACKAGE_LIBOPENSSL_ENABLE_WHIRLPOOL=y
BR2_PACKAGE_LIBOPENSSL_ENABLE_BLOWFISH=y
BR2_PACKAGE_LIBOPENSSL_ENABLE_SSL=y
BR2_PACKAGE_LIBOPENSSL_ENABLE_SSL3=y
BR2_PACKAGE_LIBOPENSSL_ENABLE_WEAK_SSL=y
BR2_PACKAGE_LIBOPENSSL_ENABLE_PSK=y
BR2_PACKAGE_LIBOPENSSL_ENABLE_CAST=y
BR2_PACKAGE_LIBOPENSSL_UNSECURE=y
BR2_PACKAGE_LIBOPENSSL_DYNAMIC_ENGINE=y
BR2_PACKAGE_LIBOPENSSL_ENABLE_COMP=y
BR2_PACKAGE_TPM2_TSS=y
BR2_PACKAGE_WOLFSSL_ASM_SUPPORTS=y
BR2_PACKAGE_MONGODB_ARCH_SUPPORTS=y
BR2_PACKAGE_ROCKSDB_ARCH_SUPPORTS=y
BR2_PACKAGE_SQLITE=y
```
